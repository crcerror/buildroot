## package/yad/Config.in
```kconfig
config BR2_PACKAGE_YAD
	bool "yad"
	depends on BR2_PACKAGE_LIBGTK3_X11
	help
	  YAD (yet another dialog) is a tool for create graphical
	  dialogs from shell scripts.

	  https://github.com/v1cont/yad

comment "yad needs libgtk3 w/ X11 backend"
	depends on !BR2_PACKAGE_LIBGTK3_X11
```
